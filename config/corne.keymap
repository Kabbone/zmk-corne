#define CONFIG_WIRELESS
#define ZMK_BASE_LAYER(name, LT, RT, LM, RM, LB, RB, LH, RH)                   \
    ZMK_LAYER(                                                                 \
        name,                                                                  \
        &gresc          LT RT    &de_ae                                        \
        &kp TAB         LM RM    &de_oe                                        \
        &mo NUM         LB RB    &de_ue                                        \
        &smart_mouse    LH RH    &kp DEL                                       \
    )

#include "zmk-helpers/key-labels/42.h"
#include "base.keymap"

//{ chosen { zmk,physical-layout = &foostan_corne_6col_layout; }; };
